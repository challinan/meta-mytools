## conf/layer.conf
```bitbake
BBPATH .= ":${LAYERDIR}"
BBFILES += "${LAYERDIR}/recipes/*/*.bb \
            ${LAYERDIR}/recipes/*/*.bbappend \
            ${LAYERDIR}/recipes-*/*/*.bb \
            ${LAYERDIR}/recipes-*/*/*.bbappend"
BBFILE_COLLECTIONS += "mytools"
BBFILE_PRIORITY_mytools = "10"
BBFILE_PATTERN_mytools = "^${LAYERDIR}/"

BB_DANGLINGAPPENDS_WARNONLY = "1"
```
